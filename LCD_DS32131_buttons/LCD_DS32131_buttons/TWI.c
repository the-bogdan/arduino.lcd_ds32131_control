/*
 * TWI.c
 *
 * Created: 26.02.2020 14:02:25
 *  Author: GaD_Bogdan
 */ 

#include "TWI.h"
//=============================================================================================
void I2C_Init(void)
{
	TWBR = 32; // скорость передачи (при 16мГц получается 100кГц)
}
//=============================================================================================
void I2C_StartCondition(void)
{
	TWCR = (1<<TWINT)|(1<<TWSTA)|(1<<TWEN);		// Передаем условие стоп
	while(!(TWCR & (1<<TWINT))); // Подождем пока установится TWIN
}
//=============================================================================================
void I2C_StopCondition(void)
{
	TWCR = (1<<TWINT)|(1<<TWSTO)|(1<<TWEN);		// Передаем условие старт
}
//=============================================================================================
void I2C_SendByte(unsigned char data)
{
	TWDR = data; // Запишем байт в регистр данных
	TWCR = (1 << TWINT)|(1 << TWEN); // Включаем передачу байта
	while (!(TWCR & (1<<TWINT))); // Подождем пока установится TWIN
/*	USART_Transmit(TWSR);*/
}
//=============================================================================================
void I2C_SendByteByAddr(unsigned char data, unsigned char addr)
{
	I2C_StartCondition();		// Передаем условие старт
	I2C_SendByte(addr);			// Передаем адрес устройства, к которому обращаемся
	I2C_SendByte(data);			// Передаем данные
	I2C_StopCondition();		// Передаем условие стоп
}
//=============================================================================================
unsigned char I2C_ReadByte(void)
{
	TWCR = (1<<TWINT)|(1<<TWEN)|(1<<TWEA); // Включим прием данных
	while (!(TWCR & (1<<TWINT)));  // Подождем пока установится TWIN
	return TWDR;
}
//=============================================================================================
unsigned char I2C_ReadLastByte(void)
{
	TWCR = (1<<TWINT)|(1<<TWEN); // Включим прием данных
	while (!(TWCR & (1<<TWINT))); // Подождем пока установится TWIN
	return TWDR;
}